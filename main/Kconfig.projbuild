## main/Kconfig.projbuild
```kconfig
menu "Micromouse Configuration"

    orsource "$IDF_PATH/examples/common_components/env_caps/$IDF_TARGET/Kconfig.env_caps"

    choice BLINK_LED
        prompt "Blink LED type"
        default BLINK_LED_GPIO if IDF_TARGET_ESP32 || !SOC_RMT_SUPPORTED
        default BLINK_LED_RMT
        help
            Defines the default peripheral for blink example

        config BLINK_LED_GPIO
            bool "GPIO"
        config BLINK_LED_RMT
            bool "RMT - Addressable LED"
    endchoice

    config BLINK_GPIO
        int "Blink GPIO number"
        range ENV_GPIO_RANGE_MIN ENV_GPIO_OUT_RANGE_MAX
        default 5 if IDF_TARGET_ESP32
        default 18 if IDF_TARGET_ESP32S2
        default 48 if IDF_TARGET_ESP32S3
        default 8
        help
            GPIO number (IOxx) to blink on and off or the RMT signal for the addressable LED.
            Some GPIOs are used for other purposes (flash connections, etc.) and cannot be used to blink.

    config BLINK_PERIOD
        int "Blink period in ms"
        range 10 3600000
        default 1000
        help
            Define the blinking period in milliseconds.

    config BLINK_PATTERN_MORSE
        bool "Blink in Morse code"
        default false
        help
            Define the blinking pattern.

    config BLINK_PATTERN_MORSE_TEXT
        depends on BLINK_PATTERN_MORSE
        string "Blink in Morse code"
        default "SOS"
        help
            Define the blinking pattern.

    config MICROMOUSE_UNITTEST_MODE
        bool "Build unittests instead of the main app"
        default false
        help
            Select running mode.

    config PID_LOOP_PERIOD
        int "PID loop period in µs"
        range 1000 20000
        default 5000
        help
            Define the PID loop period in microseconds.

endmenu
```
